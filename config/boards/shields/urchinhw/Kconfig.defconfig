## config/boards/shields/urchinhw/Kconfig.defconfig
```kconfig
if SHIELD_URCHIN_LEFT

# Name must be less than 16 characters long!
config ZMK_URCHINHW
    default "urchinhw"

config ZMK_SPLIT_ROLE_CENTRAL
    default y

endif

if SHIELD_URCHINHW_LEFT || SHIELD_URCHINHW_RIGHT

config ZMK_SPLIT
    default y

endif
```

## config/boards/shields/urchinhw/Kconfig.shield
```kconfig
# No whitespace after the comma or in your part name!
 config SHIELD_URCHINHW_LEFT
    def_bool $(shields_list_contains,urchinhw_left)

config SHIELD_URCHINHW_RIGHT
    def_bool $(shields_list_contains,urchinhw_right)
```
